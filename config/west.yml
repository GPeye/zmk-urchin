## config/west.yml
```yaml
manifest:
  remotes:
    - name: gpeye
      url-base: https://github.com/GPeye
  projects:
    - name: zmk
      remote: gpeye
      revision: main
      import: app/west.yml
    - name: urchin-peripheral-animation
      remote: gpeye
      revision: main
  self:
    path: config
```
